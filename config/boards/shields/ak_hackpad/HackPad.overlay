/ {
    chosen {
        zmk,kscan = &default_kscan;
    };

    default_kscan: kscan {
        compatible = "zmk,kscan-gpio-direct";
        label = "default_kscan";
        input-gpios = <&gpio0 26 (GPIO_ACTIVE_LOW | GPIO_PULL_UP)>,
                    <&gpio0 1 (GPIO_ACTIVE_LOW | GPIO_PULL_UP)>,
                    <&gpio0 4 (GPIO_ACTIVE_LOW | GPIO_PULL_UP)>,
                    <&gpio0 27 (GPIO_ACTIVE_LOW | GPIO_PULL_UP)>,
                    <&gpio0 2 (GPIO_ACTIVE_LOW | GPIO_PULL_UP)>,
                    <&gpio0 3 (GPIO_ACTIVE_LOW | GPIO_PULL_UP)>;
    };
};